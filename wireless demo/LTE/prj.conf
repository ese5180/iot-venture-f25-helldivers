## prj.conf
```kconfig
# --- 日志/控制台走 RTT，避免占用 UART ---
CONFIG_LOG=y
CONFIG_LOG_MODE_IMMEDIATE=y
CONFIG_LOG_DEFAULT_LEVEL=3
CONFIG_CONSOLE=y
CONFIG_UART_CONSOLE=n
CONFIG_RTT_CONSOLE=y
CONFIG_USE_SEGGER_RTT=y
CONFIG_LOG_BACKEND_RTT=y

# --- 串口与 AT host ---
CONFIG_SERIAL=y
CONFIG_UART_ASYNC_API=y
CONFIG_NRF_MODEM_LIB=y
CONFIG_AT_HOST_LIBRARY=y

# --- 堆栈/内存 ---
CONFIG_MAIN_STACK_SIZE=4096
CONFIG_HEAP_MEM_POOL_SIZE=16384
```

## prj_offline.conf
```kconfig
CONFIG_LTE_LINK_CONTROL=y
CONFIG_LTE_AUTO_INIT_AND_CONNECT=n
CONFIG_AT_HOST_LIBRARY=y
```

## src/main.c
```c
#include <zephyr/kernel.h>
#include <zephyr/logging/log.h>

LOG_MODULE_REGISTER(app, LOG_LEVEL_INF);

/* 说明：
 * CONFIG_AT_HOST_LIBRARY=y 后，at_host 会通过 SYS_INIT 自动初始化，
 * 应用里不需要 include <modem/at_host.h> 或显式调用初始化函数。
 */

int main(void)
{
    LOG_INF("at_client passthrough ready (no auto attach)");
    while (1) {
        k_sleep(K_SECONDS(1));
    }
    return 0;
}
```
