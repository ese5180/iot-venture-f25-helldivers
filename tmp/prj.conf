## prj.conf
```kconfig
########################
# General
########################
CONFIG_LOG=y
CONFIG_LOG_BUFFER_SIZE=2048
CONFIG_HW_ID_LIBRARY=y
CONFIG_ASSERT=y
CONFIG_JSON_LIBRARY=y
CONFIG_REBOOT=y

# 日志总开关等级：0=NONE, 1=ERR, 2=WRN, 3=INF, 4=DBG
CONFIG_LOG_DEFAULT_LEVEL=3

########################
# Heap and stacks
########################
CONFIG_HEAP_MEM_POOL_SIZE=8192
CONFIG_MAIN_STACK_SIZE=4096
CONFIG_SYSTEM_WORKQUEUE_STACK_SIZE=2048

########################
# Network
########################
CONFIG_NETWORKING=y
CONFIG_NET_NATIVE=y
CONFIG_NET_IPV4=y
CONFIG_NET_CONNECTION_MANAGER=y

# 不启用 Zephyr 自己的软件 TLS（我们用的是 modem offload）
# 所以这里不要 CONFIG_NET_SOCKETS_SOCKOPT_TLS

########################
# AWS IoT / MQTT
########################
CONFIG_AWS_IOT=y

# 固定 client ID（也可以改用 hw_id，这里只是兜底）
CONFIG_AWS_IOT_CLIENT_ID_STATIC="device_horse"

# 你的 AWS IoT endpoint（注意和 AWS 控制台一致）
CONFIG_AWS_IOT_BROKER_HOST_NAME="aee37ebj3uql3-ats.iot.us-east-1.amazonaws.com"

# Shadow 相关 topic 订阅
CONFIG_AWS_IOT_TOPIC_UPDATE_DELTA_SUBSCRIBE=y
CONFIG_AWS_IOT_TOPIC_GET_ACCEPTED_SUBSCRIBE=y
CONFIG_AWS_IOT_TOPIC_GET_REJECTED_SUBSCRIBE=y

# sample 里用到的一些 Kconfig（避免 undefined）
CONFIG_AWS_IOT_SAMPLE_APP_VERSION="v1.0.0"
CONFIG_AWS_IOT_SAMPLE_JSON_MESSAGE_SIZE_MAX=1024
CONFIG_AWS_IOT_SAMPLE_PUBLICATION_INTERVAL_SECONDS=60
CONFIG_AWS_IOT_SAMPLE_CONNECTION_RETRY_TIMEOUT_SECONDS=10

# 使用硬件 ID 作为 device_id（配合 main.c 里的 hw_id_get）
CONFIG_AWS_IOT_SAMPLE_DEVICE_ID_USE_HW_ID=y

########################
# MQTT helper library
########################
CONFIG_MQTT_HELPER=y
CONFIG_MQTT_HELPER_SEC_TAG=201
CONFIG_MQTT_HELPER_LAST_WILL=y
CONFIG_MQTT_HELPER_STACK_SIZE=4096


CONFIG_MQTT_HELPER_PORT=8883

# Maximum MQTT keepalive timeout specified by AWS IoT Core
CONFIG_MQTT_KEEPALIVE=1200
CONFIG_MQTT_CLEAN_SESSION=y

########################
# Modem / LTE
########################

# 让 socket 走 nRF91 调制解调器（包含 TLS offload）
CONFIG_NET_SOCKETS_OFFLOAD=y

# LTE 链路控制
CONFIG_LTE_LINK_CONTROL=y

# 只用 LTE-M
CONFIG_LTE_NETWORK_MODE_LTE_M=y

########################
# PDN / APN 配置
########################
CONFIG_PDN=y
CONFIG_PDN_DEFAULTS_OVERRIDE=y
CONFIG_PDN_DEFAULT_APN="onomodo"

########################
# Modem key management (证书)
########################
CONFIG_MODEM_KEY_MGMT=y

########################
# Modem info（给 shadow 里面的 modem_version 用）
########################
CONFIG_MODEM_INFO=y
```

## src/main.c
```c
#include <zephyr/kernel.h>
#include <zephyr/sys/reboot.h>
#include <zephyr/dfu/mcuboot.h>
#include <zephyr/logging/log.h>
#include <zephyr/logging/log_ctrl.h>
#include <zephyr/net/conn_mgr_connectivity.h>
#include <zephyr/net/conn_mgr_monitor.h>
#include <net/aws_iot.h>
#include <stdio.h>
#include <stdlib.h>
#include <hw_id.h>
#include <modem/modem_info.h>

#include "json_payload.h"

#include <nrf_modem.h>
#include <modem/lte_lc.h>
///////////////////timestamp////////////////////////////
#include <modem/at_cmd.h>
#include <zephyr/sys/timeutil.h>
static int64_t get_modem_timestamp(void)
{
    char resp[64];
    int err;

    /* 查询 LTE 网络时间 */
    err = at_cmd_write("AT%XTIME?", resp, sizeof(resp), NULL);
    if (err) {
        printk("AT%%XTIME? failed: %d\n", err);
        return -1;
    }

    char *p = strstr(resp, "%XTIME: ");
    if (!p) {
        printk("Unexpected XTIME response: %s\n", resp);
        return -1;
    }
    p += 8; // skip "%XTIME: "

    char buf[3] = {0};

    buf[0] = p[0]; buf[1] = p[1];
    int year = 2000 + atoi(buf);

    buf[0] = p[2]; buf[1] = p[3];
    int month = atoi(buf);

    buf[0] = p[4]; buf[1] = p[5];
    int day = atoi(buf);

    buf[0] = p[6]; buf[1] = p[7];
    int hour = atoi(buf);

    buf[0] = p[8]; buf[1] = p[9];
    int minute = atoi(buf);

    buf[0] = p[10]; buf[1] = p[11];
    int second = atoi(buf);

    struct tm t = {
        .tm_year = year - 1900,
        .tm_mon  = month - 1,
        .tm_mday = day,
        .tm_hour = hour,
        .tm_min  = minute,
        .tm_sec  = second,
    };

    return (int64_t)timeutil_timegm(&t);
}
////////
#include "horse_payload.h"
void publish_horse_data(float temperature, float moisture, float pitch,
                        float gps_lat, float gps_lon)
{
    char json_buf[256];
    struct horse_payload hp;

    /* === 使用 modem 时间作为 timestamp === */
    hp.timestamp = get_modem_timestamp();

    hp.temperature = (int32_t)(temperature * 100.0f);
    hp.moisture    = (int32_t)(moisture * 100.0f);
    hp.pitch       = (int32_t)(pitch * 100.0f);
    hp.latitude    = (int32_t)(gps_lat * 1000000.0f);
    hp.longitude   = (int32_t)(gps_lon * 1000000.0f);

    if (horse_payload_construct(json_buf, sizeof(json_buf), &hp)) {
        printk("horse_payload_construct failed\n");
        return;
    }

    struct aws_iot_data tx = { 0 };
    tx.qos       = MQTT_QOS_1_AT_LEAST_ONCE;
    tx.ptr       = json_buf;
    tx.len       = strlen(json_buf);
    tx.topic.str = "horse_data";
    tx.topic.len = strlen(tx.topic.str);

    aws_iot_send(&tx);
    printk("horse_data sent: %s\n", json_buf);
}



LOG_MODULE_REGISTER(aws_iot_sample, CONFIG_AWS_IOT_SAMPLE_LOG_LEVEL);

#define L4_EVENT_MASK         (NET_EVENT_L4_CONNECTED | NET_EVENT_L4_DISCONNECTED)
#define CONN_LAYER_EVENT_MASK (NET_EVENT_CONN_IF_FATAL_ERROR)

#define MODEM_FIRMWARE_VERSION_SIZE_MAX 50

#define MY_CUSTOM_TOPIC_1 "my-custom-topic/example"
#define MY_CUSTOM_TOPIC_2 "my-custom-topic/example_2"

#define FATAL_ERROR()                             \
    LOG_ERR("Fatal error! Rebooting the device.");\
    LOG_PANIC();                                  \
    IF_ENABLED(CONFIG_REBOOT, (sys_reboot(0)))

static struct net_mgmt_event_callback l4_cb;
static struct net_mgmt_event_callback conn_cb;

static char hw_id[HW_ID_LEN];

static void shadow_update_work_fn(struct k_work *work);
static void connect_work_fn(struct k_work *work);
static void aws_iot_event_handler(const struct aws_iot_evt *const evt);

static K_WORK_DELAYABLE_DEFINE(shadow_update_work, shadow_update_work_fn);
static K_WORK_DELAYABLE_DEFINE(connect_work, connect_work_fn);

/* ================= Application topics ================= */

static int app_topics_subscribe(void)
{
    int err;
    static const struct mqtt_topic topic_list[] = {
        {
            .topic.utf8 = MY_CUSTOM_TOPIC_1,
            .topic.size = sizeof(MY_CUSTOM_TOPIC_1) - 1,
            .qos = MQTT_QOS_1_AT_LEAST_ONCE,
        },
        {
            .topic.utf8 = MY_CUSTOM_TOPIC_2,
            .topic.size = sizeof(MY_CUSTOM_TOPIC_2) - 1,
            .qos = MQTT_QOS_1_AT_LEAST_ONCE,
        },
        {
            .topic.utf8 = "horse_data",
            .topic.size = sizeof("horse_data") - 1,
            .qos = MQTT_QOS_1_AT_LEAST_ONCE,
        }
    };

    err = aws_iot_application_topics_set(topic_list, ARRAY_SIZE(topic_list));
    if (err) {
        LOG_ERR("aws_iot_application_topics_set, error: %d", err);
        FATAL_ERROR();
        return err;
    }

    return 0;
}

/* ================= AWS IoT client init ================= */

static int aws_iot_client_init(void)
{
    int err;

    printk("=== aws_iot_client_init: start ===\n");

    err = aws_iot_init(aws_iot_event_handler);
    if (err) {
        LOG_ERR("AWS IoT library could not be initialized, error: %d", err);
        FATAL_ERROR();
        return err;
    }

    printk("=== aws_iot_client_init: aws_iot_init OK ===\n");

    err = app_topics_subscribe();
    if (err) {
        LOG_ERR("Adding application specific topics failed, error: %d", err);
        FATAL_ERROR();
        return err;
    }

    printk("=== aws_iot_client_init: topics subscribed OK ===\n");

    return 0;
}

/* ================= Shadow update work ================= */

static void shadow_update_work_fn(struct k_work *work)
{
    int err;
    char message[CONFIG_AWS_IOT_SAMPLE_JSON_MESSAGE_SIZE_MAX] = { 0 };
    struct payload payload = {
        .state.reported.uptime = k_uptime_get(),
        .state.reported.app_version = CONFIG_AWS_IOT_SAMPLE_APP_VERSION,
    };
    struct aws_iot_data tx_data = {
        .qos = MQTT_QOS_0_AT_MOST_ONCE,
        .topic.type = AWS_IOT_SHADOW_TOPIC_UPDATE,
    };

    if (IS_ENABLED(CONFIG_MODEM_INFO)) {
        char modem_version_temp[MODEM_FIRMWARE_VERSION_SIZE_MAX];

        err = modem_info_get_fw_version(modem_version_temp,
                        ARRAY_SIZE(modem_version_temp));
        if (err) {
            LOG_ERR("modem_info_get_fw_version, error: %d", err);
            FATAL_ERROR();
            return;
        }

        payload.state.reported.modem_version = modem_version_temp;
    }

    err = json_payload_construct(message, sizeof(message), &payload);
    if (err) {
        LOG_ERR("json_payload_construct, error: %d", err);
        FATAL_ERROR();
        return;
    }

    tx_data.ptr = message;
    tx_data.len = strlen(message);

    LOG_INF("Publishing message: %s to AWS IoT shadow", message);

    err = aws_iot_send(&tx_data);
    if (err) {
        LOG_ERR("aws_iot_send, error: %d", err);
        FATAL_ERROR();
        return;
    }

    (void)k_work_reschedule(&shadow_update_work,
        K_SECONDS(CONFIG_AWS_IOT_SAMPLE_PUBLICATION_INTERVAL_SECONDS));
}

/* ================= Connect work ================= */

static void connect_work_fn(struct k_work *work)
{
    int err;
    const struct aws_iot_config config = {
        .client_id = hw_id,
    };

    LOG_INF("Connecting to AWS IoT (client_id: %s, host: %s, port: %d)",
        hw_id,
        CONFIG_AWS_IOT_BROKER_HOST_NAME,
#ifdef CONFIG_MQTT_HELPER_PORT
        CONFIG_MQTT_HELPER_PORT
#else
        -1
#endif
    );

    err = aws_iot_connect(&config);
    printk("=== connect_work_fn: aws_iot_connect() returned: %d ===\n", err);

    if (err == -EAGAIN) {
        LOG_INF("Connection attempt timed out, next retry in %d seconds",
            CONFIG_AWS_IOT_SAMPLE_CONNECTION_RETRY_TIMEOUT_SECONDS);

        (void)k_work_reschedule(&connect_work,
            K_SECONDS(CONFIG_AWS_IOT_SAMPLE_CONNECTION_RETRY_TIMEOUT_SECONDS));
    } else if (err) {
        LOG_ERR("aws_iot_connect, error: %d", err);
        FATAL_ERROR();
    }
}

/* ================= AWS IoT event handler ================= */

static void on_aws_iot_evt_connected(const struct aws_iot_evt *const evt)
{
    (void)k_work_cancel_delayable(&connect_work);

    if (evt->data.persistent_session) {
        LOG_WRN("Persistent session enabled, reusing subscriptions");
    }

#if defined(CONFIG_BOOTLOADER_MCUBOOT)
    boot_write_img_confirmed();
#endif
    float temperature = 23.5f;
    float moisture    = 56.7f;
    float pitch       = 12.8f;
    float gps_lat     = 39.952213f;
    float gps_lon     = -75.193456f;

    /* Convert to integers */
    int32_t temp_i = (int32_t)(temperature * 100.0f);
    int32_t moist_i = (int32_t)(moisture * 100.0f);
    int32_t pitch_i = (int32_t)(pitch * 100.0f);
    int32_t lat_i = (int32_t)(gps_lat * 1000000.0f);
    int32_t lon_i = (int32_t)(gps_lon * 1000000.0f);

    /* Print both raw and converted */
    printk("RAW BEFORE SEND:\n");
    printk("  int     t=%d  m=%d  p=%d  lat=%d  lon=%d\n",
           temp_i, moist_i, pitch_i, lat_i, lon_i);

    /* Publish integer version */
    publish_horse_data(temperature, moisture, pitch, gps_lat, gps_lon);

    (void)k_work_reschedule(&shadow_update_work, K_NO_WAIT);
}

static void on_aws_iot_evt_disconnected(void)
{
    (void)k_work_cancel_delayable(&shadow_update_work);
    (void)k_work_reschedule(&connect_work, K_SECONDS(5));
}

static void aws_iot_event_handler(const struct aws_iot_evt *const evt)
{
    switch (evt->type) {
    case AWS_IOT_EVT_CONNECTING:
        LOG_INF("AWS_IOT_EVT_CONNECTING");
        break;
    case AWS_IOT_EVT_CONNECTED:
        LOG_INF("AWS_IOT_EVT_CONNECTED");
        on_aws_iot_evt_connected(evt);
        break;
    case AWS_IOT_EVT_DISCONNECTED:
        LOG_INF("AWS_IOT_EVT_DISCONNECTED");
        on_aws_iot_evt_disconnected();
        break;
    case AWS_IOT_EVT_DATA_RECEIVED:
        LOG_INF("AWS_IOT_EVT_DATA_RECEIVED");
        LOG_INF("Received: \"%.*s\" on \"%.*s\"",
            evt->data.msg.len, evt->data.msg.ptr,
            evt->data.msg.topic.len, evt->data.msg.topic.str);
        break;
    case AWS_IOT_EVT_PUBACK:
        LOG_INF("AWS_IOT_EVT_PUBACK id=%d", evt->data.message_id);
        break;
    case AWS_IOT_EVT_PINGRESP:
        LOG_INF("AWS_IOT_EVT_PINGRESP");
        break;
    case AWS_IOT_EVT_ERROR:
        LOG_INF("AWS_IOT_EVT_ERROR %d", evt->data.err);
        FATAL_ERROR();
        break;
    default:
        LOG_WRN("Unknown AWS IoT event %d", evt->type);
        break;
    }
}

/* ================= Network event handlers ================= */

static void l4_event_handler(struct net_mgmt_event_callback *cb,
                 uint32_t event,
                 struct net_if *iface)
{
    switch (event) {
    case NET_EVENT_L4_CONNECTED:
        LOG_INF("Network connectivity established");
        printk("=== L4_CONNECTED: scheduling connect_work ===\n");

        (void)k_work_schedule(&connect_work, K_NO_WAIT);
        break;
    case NET_EVENT_L4_DISCONNECTED:
        LOG_INF("Network connectivity lost");
        break;
    default:
        return;
    }
}

static void connectivity_event_handler(struct net_mgmt_event_callback *cb,
                       uint32_t event,
                       struct net_if *iface)
{
    if (event == NET_EVENT_CONN_IF_FATAL_ERROR) {
        LOG_ERR("NET_EVENT_CONN_IF_FATAL_ERROR");
        FATAL_ERROR();
    }
}

/* ============================ main ============================ */

int main(void)
{
    int err;
    extern int provision_credentials(void);

    LOG_INF("The AWS IoT sample started, version: %s",
        CONFIG_AWS_IOT_SAMPLE_APP_VERSION);

    printk("=== HELLDIVERS AWS MAIN, built at " __DATE__ " " __TIME__ " ===\n");

    
    net_mgmt_init_event_callback(&l4_cb, l4_event_handler, L4_EVENT_MASK);
    net_mgmt_add_event_callback(&l4_cb);

    net_mgmt_init_event_callback(&conn_cb, connectivity_event_handler,
                     CONN_LAYER_EVENT_MASK);
    net_mgmt_add_event_callback(&conn_cb);

    LOG_INF("Bringing network interface up and connecting");
    printk("=== Before conn_mgr_all_if_up ===\n");

    /* 2. 让 conn_mgr 初始化 modem 并 bring up 接口 */
    err = conn_mgr_all_if_up(true);
    printk("=== conn_mgr_all_if_up() returned: %d ===\n", err);
    if (err) {
        LOG_ERR("conn_mgr_all_if_up error: %d", err);
        FATAL_ERROR();
        return err;
    }

    
    err = provision_credentials();
    if (err) {
        LOG_ERR("provision_credentials failed: %d", err);
        FATAL_ERROR();
        return err;
    }

    printk("=== Before conn_mgr_all_if_connect ===\n");
    err = conn_mgr_all_if_connect(true);
    printk("=== conn_mgr_all_if_connect() returned: %d ===\n", err);
    if (err) {
        LOG_ERR("conn_mgr_all_if_connect error: %d", err);
        FATAL_ERROR();
        return err;
    }

#if defined(CONFIG_AWS_IOT_SAMPLE_CLIENT_ID_USE_HW_ID)
    printk("=== Before hw_id_get ===\n");
    err = hw_id_get(hw_id, ARRAY_SIZE(hw_id));
    printk("=== hw_id_get() returned: %d ===\n", err);
    if (err) {
        LOG_ERR("Failed to retrieve hardware ID, error: %d", err);
        FATAL_ERROR();
        return err;
    }
    LOG_INF("Hardware ID: %s", hw_id);
    printk("=== Hardware ID: %s ===\n", hw_id);
#else
    snprintf(hw_id, sizeof(hw_id), "%s", CONFIG_AWS_IOT_CLIENT_ID_STATIC);
    LOG_INF("Using static client ID as hw_id: %s", hw_id);
    printk("=== Using static client ID as hw_id: %s ===\n", hw_id);
#endif

    printk("=== Before aws_iot_client_init ===\n");
    err = aws_iot_client_init();
    printk("=== aws_iot_client_init() returned: %d ===\n", err);
    if (err) {
        LOG_ERR("aws_iot_client_init error: %d", err);
        FATAL_ERROR();
        return err;
    }

    if (IS_ENABLED(CONFIG_BOARD_NATIVE_SIM)) {
        conn_mgr_mon_resend_status();
    }

    printk("=== main() finished, waiting for events ===\n");

    return 0;
}
```

## src/cert_provision.c
```c
#include <zephyr/kernel.h>
#include <modem/modem_key_mgmt.h>
#include <zephyr/logging/log.h>

LOG_MODULE_REGISTER(cert_provision, LOG_LEVEL_INF);

#define AWS_SEC_TAG 201

/* ====== Your AWS Certificates ====== */

static const char root_ca[] =
"-----BEGIN CERTIFICATE-----\n"
"MIIDQTCCAimgAwIBAgITBmyfz5m/jAo54vB4ikPmljZbyjANBgkqhkiG9w0BAQsF\n"
"ADA5MQswCQYDVQQGEwJVUzEPMA0GA1UEChMGQW1hem9uMRkwFwYDVQQDExBBbWF6\n"
"b24gUm9vdCBDQSAxMB4XDTE1MDUyNjAwMDAwMFoXDTM4MDExNzAwMDAwMFowOTEL\n"
"MAkGA1UEBhMCVVMxDzANBgNVBAoTBkFtYXpvbjEZMBcGA1UEAxMQQW1hem9uIFJv\n"
"b3QgQ0EgMTCCASIwDQYJKoZIhvcNAQEBBQADggEPADCCAQoCggEBALJ4gHHKeNXj\n"
"ca9HgFB0fW7Y14h29Jlo91ghYPl0hAEvrAIthtOgQ3pOsqTQNroBvo3bSMgHFzZM\n"
"9O6II8c+6zf1tRn4SWiw3te5djgdYZ6k/oI2peVKVuRF4fn9tBb6dNqcmzU5L/qw\n"
"IFAGbHrQgLKm+a/sRxmPUDgH3KKHOVj4utWp+UhnMJbulHheb4mjUcAwhmahRWa6\n"
"VOujw5H5SNz/0egwLX0tdHA114gk957EWW67c4cX8jJGKLhD+rcdqsq08p8kDi1L\n"
"93FcXmn/6pUCyziKrlA4b9v7LWIbxcceVOF34GfID5yHI9Y/QCB/IIDEgEw+OyQm\n"
"jgSubJrIqg0CAwEAAaNCMEAwDwYDVR0TAQH/BAUwAwEB/zAOBgNVHQ8BAf8EBAMC\n"
"AYYwHQYDVR0OBBYEFIQYzIU07LwMlJQuCFmcx7IQTgoIMA0GCSqGSIb3DQEBCwUA\n"
"A4IBAQCY8jdaQZChGsV2USggNiMOruYou6r4lK5IpDB/G/wkjUu0yKGX9rbxenDI\n"
"U5PMCCjjmCXPI6T53iHTfIUJrU6adTrCC2qJeHZERxhlbI1Bjjt/msv0tadQ1wUs\n"
"N+gDS63pYaACbvXy8MWy7Vu33PqUXHeeE6V/Uq2V8viTO96LXFvKWlJbYK8U90vv\n"
"o/ufQJVtMVT8QtPHRh8jrdkPSHCa2XV4cdFyQzR1bldZwgJcJmApzyMZFo6IQ6XU\n"
"5MsI+yMRQ+hDKXJioaldXgjUkK642M4UwtBV8ob2xJNDd2ZhwLnoQdeXeGADbkpy\n"
"rqXRfboQnoZsG4q5WTP468SQvvG5\n"
"-----END CERTIFICATE-----\n";



static const char client_cert[] =
"-----BEGIN CERTIFICATE-----\n"
"MIIDWTCCAkGgAwIBAgIUfRIiGhr8/73rT+ubKv/+6jgNK8owDQYJKoZIhvcNAQEL\n"
"BQAwTTFLMEkGA1UECwxCQW1hem9uIFdlYiBTZXJ2aWNlcyBPPUFtYXpvbi5jb20g\n"
"SW5jLiBMPVNlYXR0bGUgU1Q9V2FzaGluZ3RvbiBDPVVTMB4XDTI1MTExODAwMjAx\n"
"MVoXDTQ5MTIzMTIzNTk1OVowHjEcMBoGA1UEAwwTQVdTIElvVCBDZXJ0aWZpY2F0\n"
"ZTCCASIwDQYJKoZIhvcNAQEBBQADggEPADCCAQoCggEBANqUPspdcJdFUOHdpI+Q\n"
"bpyL6UEb1HdQcj5LjUkZT61nek3wpXI5YzYgrXEjK/FiJJppJZ5+U+B8x9ZtGPIo\n"
"Q7dD/t+j8l+CzFJOKorGT5k8PJVBPYMYWpfVINPq3x62waqvWDWtaMHub/FQEug1\n"
"FNAeynnaQPo9eas4aCDUS9y5hlFifVCoAUxZM6nSilPDFSAe9e0MyxAIXwf/N66F\n"
"RkUMwq3ilcYKB99+fNXhGKgz+Nc2h81QSLLAuUd2rgr1PVExxP4f7FmyHEVyDR15\n"
"PIQ4/UANN+our2rsGm71qO0mGf99CIaZ+yGYjdU3lSXRDbK4rA4Y2svJpTsabAh7\n"
"PXkCAwEAAaNgMF4wHwYDVR0jBBgwFoAUfKT0cOGSGRDzwA5YdV7cKl3PjXswHQYD\n"
"VR0OBBYEFFigHOlfVQd5pydbwRqSmBchyp8pMAwGA1UdEwEB/wQCMAAwDgYDVR0P\n"
"AQH/BAQDAgeAMA0GCSqGSIb3DQEBCwUAA4IBAQCMNJtVndFhj1TbruOeV7QEU6rQ\n"
"694005dVZYTDp3+Z4vQWBwr9ZFmkZO6Q37PdTCQT4JZBzTdxHW8/auN2EO+b6n/5\n"
"AfMESaF+oXP/aoGCeZJp/j4cfPuIXQSUB0gy84y8ZHXRamFkfHSjAwJVkh84aEr2\n"
"6g3ueG2NgRv0KdMsuraRjUyPx8AGa/BEQkfTir9O7z+orAIfLVIfA63ZMIWr3hnA\n"
"JCrGqlSVpFGDoU7ys93LbAO3nZmi2xy0MzCykR2Ju/4OHEq667SWigOocNBO704T\n"
"HeeL0H072lWL2K/UNmk0FaoHWdnwHCjIqecp7aM80Zctvg9O6LdvKlWTr/+0\n"
"-----END CERTIFICATE-----\n";



static const char client_key[] =
"-----BEGIN RSA PRIVATE KEY-----\n"
"MIIEpAIBAAKCAQEA2pQ+yl1wl0VQ4d2kj5BunIvpQRvUd1ByPkuNSRlPrWd6TfCl\n"
"cjljNiCtcSMr8WIkmmklnn5T4HzH1m0Y8ihDt0P+36PyX4LMUk4qisZPmTw8lUE9\n"
"gxhal9Ug0+rfHrbBqq9YNa1owe5v8VAS6DUU0B7KedpA+j15qzhoINRL3LmGUWJ9\n"
"UKgBTFkzqdKKU8MVIB717QzLEAhfB/83roVGRQzCreKVxgoH33581eEYqDP41zaH\n"
"zVBIssC5R3auCvU9UTHE/h/sWbIcRXINHXk8hDj9QA036i6vauwabvWo7SYZ/30I\n"
"hpn7IZiN1TeVJdENsrisDhjay8mlOxpsCHs9eQIDAQABAoIBAHor+Di2J5N1u/Kz\n"
"JyLTcO/xR+wLeSNDhMeLBSqBikZ7GyJrSp5gszJy617ccNhXqevgr5U6OPm15SDW\n"
"E+ZuWQMbb19jTLrT6g5rAF5W3/DfeWFXeOFIgIJzLwkkM5gAQJl9rok6Jt6Wvl0c\n"
"C6Vc3ghB3ZxkQINeTx5DxffrkYeJ5re9kpdhWPTjXsf8mHmvLAXsMYASg7dkI6z0\n"
"g6N6Wa5YxqhEBX0ZHiTI7tkBfWJsa00jRbR8DoYNOCK2nx2xzUG7g+Ruu8leARjt\n"
"TfTxu7hsGzBz0hkA/7oyB4lH/xtJKIdPCYfvU1MBuVX4Hvl/eGWa9snuGorRILov\n"
"8tNmU70CgYEA7cGQhvrILw0F8K7bVLcrGhkB7ot7wvf+N3dl8KADqdACjDjpX8Ni\n"
"oUFjLzSkxAyULtLScSVXhv5dq9jUaZvHL+qcAj+ICTWZwqQ57XmSPm8jLsXwqrR5\n"
"Vce11GK2nq8VKpTQ9zLwItta9S6HCLwsvbE5KTjoS6xm4mv/K/DfRkMCgYEA61n4\n"
"iX68txEmL/gDioV8GuNi1c1RIRJmntbBkdzk6UrKXya+wolgT5rSS7VYty0Lb8wW\n"
"L/+hr3h35Caf9ldeyMhionbmU3KF2DGvYpiwEHfkNgfI4UqDSRutLghkTPQsdSsm\n"
"Dhrx4bTpeNAp9ILBfaCDuPJFIyKTLJ8XBawEt5MCgYEAnQXQwQTRvxlXyfyByLJs\n"
"WgEYIIaohzyn/dPyVHgp0zYY6KkRoHh3JE7+BYg8JWq1VzNPXwCtjO9jyAIdT15d\n"
"sAy/WlDBNGvdEArMY0V+S5O05cg+yU8GL5wFP66uM6EoVoYQeKKArFS4/uLqtd8p\n"
"oWJxgQMfkBLdpD51OX0MyOcCgYBif1EJGkWYyFCXGtFAlAUQq8GdgURG9xCDwZVZ\n"
"mn0jNe3kTK7hc+Ue68i/brImV2/F5kAS7oWYjm5+ybuAuagtl8/P9rsGiZOCm6iv\n"
"Nv/YpJSaGD/2Kd0wJ6ke7twraLWChAB1PsmkkLZ1nYkxj9ey4A7AxIQy5DF8J0jX\n"
"UtrWiQKBgQDLbTrVZUAwA5SeC28qBJkPywV+b4sji5yQjI3e4euoveAGZLdmQ9cf\n"
"ekNrmP5LXtNWwqZUxjpBFOmBEr3HjAK+XWouUa5y2Lf0ttyLfho7qO9CauFbCfFL\n"
"7hMGg8+2qoXIZhOMfnWgI0EfFQ28yOuzSa8B5Ej3uDoV8fvj5cB7zA==\n"
"-----END RSA PRIVATE KEY-----\n";



/* ====== Helper: check if credential exists ====== */
static bool cred_exists(uint16_t tag, enum modem_key_mgmt_cred_type type)
{
    size_t len = 0;
    int err = modem_key_mgmt_read(tag, type, NULL, &len);

    return (err == 0 && len > 0);
}

/* ====== Provision one credential if missing ====== */
static int write_if_missing(uint16_t tag,
                            enum modem_key_mgmt_cred_type type,
                            const char *pem)
{
    if (cred_exists(tag, type)) {
        LOG_INF("Credential type %d already exists. Skipping.", type);
        return 0;
    }

    LOG_INF("Writing credential type %d ...", type);
    return modem_key_mgmt_write(tag, type, pem, strlen(pem));
}

/* ====== Public function called by main() ====== */
int provision_credentials(void)
{
    int err;

	/* 1) Root CA */
	err = write_if_missing(AWS_SEC_TAG,
		MODEM_KEY_MGMT_CRED_TYPE_CA_CHAIN,
		root_ca);

	/* 2) Client certificate */
	err = write_if_missing(AWS_SEC_TAG,
		MODEM_KEY_MGMT_CRED_TYPE_PUBLIC_CERT,
		client_cert);

	/* 3) Private key */
	err = write_if_missing(AWS_SEC_TAG,
		MODEM_KEY_MGMT_CRED_TYPE_PRIVATE_CERT,
		client_key);

    if (err) return err;

    LOG_INF("All AWS credentials provisioned successfully.");
    return 0;
}
```
