## CMakeLists.txt
```
cmake_minimum_required(VERSION 3.20.0)
find_package(Zephyr REQUIRED HINTS $ENV{ZEPHYR_BASE})
project(at_client_offline)

target_sources(app PRIVATE src/main.c)
```

## prj.conf
```kconfig
# --- 日志 / 控制台走 UART ---
CONFIG_LOG=y
CONFIG_LOG_MODE_IMMEDIATE=y
CONFIG_LOG_DEFAULT_LEVEL=3

# 控制台和日志都使用 UART
CONFIG_CONSOLE=y
CONFIG_UART_CONSOLE=y
CONFIG_RTT_CONSOLE=n
CONFIG_USE_SEGGER_RTT=n
CONFIG_LOG_BACKEND_RTT=n
CONFIG_LOG_BACKEND_UART=y

# --- 串口与 AT host ---
CONFIG_SERIAL=y
CONFIG_UART_ASYNC_API=y
CONFIG_NRF_MODEM_LIB=y
CONFIG_AT_HOST_LIBRARY=y

# --- 堆栈/内存 ---
CONFIG_MAIN_STACK_SIZE=4096
CONFIG_HEAP_MEM_POOL_SIZE=16384

# --- TF-M 设置 ---
CONFIG_TFM_SECURE_UART0=n
CONFIG_TFM_LOG_LEVEL_SILENCE=y
```

## src/main.c
```c
#include <zephyr/kernel.h>
#include <zephyr/logging/log.h>
LOG_MODULE_REGISTER(app, LOG_LEVEL_INF);

int main(void)
{
    printk("printk test via RTT\n");
    LOG_INF("LOG_INF test via RTT");
    while (1) {
        k_sleep(K_SECONDS(1));
    }
}
```
