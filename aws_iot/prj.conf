## CMakeLists.txt
```
#
# Copyright (c) 2020 Nordic Semiconductor
#
# SPDX-License-Identifier: LicenseRef-Nordic-5-Clause
#

cmake_minimum_required(VERSION 3.20.0)

find_package(Zephyr REQUIRED HINTS $ENV{ZEPHYR_BASE})
project(aws_iot)

# NORDIC SDK APP START
target_sources(app PRIVATE src/main.c)
target_sources(app PRIVATE src/json_payload/json_payload.c)
target_sources(app PRIVATE src/horse_payload/horse_payload.c)
target_sources(app PRIVATE src/cert_provision.c)
zephyr_library_sources(src/gnss/gnss_task.c)
# NORDIC SDK APP END

zephyr_include_directories(src)
zephyr_include_directories(src/json_payload)
zephyr_include_directories(src/horse_payload)
zephyr_include_directories(src/gnss)

zephyr_library_sources_ifdef(CONFIG_GNSS_SAMPLE_ASSISTANCE_MINIMAL src/gnss/assistance_minimal.c)
zephyr_library_sources_ifdef(CONFIG_GNSS_SAMPLE_ASSISTANCE_MINIMAL src/gnss/mcc_location_table.c)
```

## prj.conf
```kconfig
########################
# General
########################
CONFIG_LOG=y
CONFIG_LOG_BUFFER_SIZE=2048
CONFIG_HW_ID_LIBRARY=y
CONFIG_ASSERT=y
CONFIG_JSON_LIBRARY=y
CONFIG_REBOOT=y

CONFIG_STDOUT_CONSOLE=y
CONFIG_UART_INTERRUPT_DRIVEN=y
CONFIG_PICOLIBC_IO_FLOAT=y
CONFIG_LOG_MODE_IMMEDIATE=y
# 日志总开关等级：0=NONE, 1=ERR, 2=WRN, 3=INF, 4=DBG
CONFIG_LOG_DEFAULT_LEVEL=3

########################
# GNSS / nRF Cloud (可选，用于 A-GNSS)
########################
# 如果后面不打算用 nRF Cloud A-GNSS，也可以把这一行改成 n
CONFIG_NRF_CLOUD=y

#CONFIG_GNSS_SAMPLE_ASSISTANCE_NRF_CLOUD=n

# Request eDRX from the network
CONFIG_LTE_LC_EDRX_MODULE=n
CONFIG_LTE_EDRX_REQ=n

# PSM requested periodic TAU 8 hours
CONFIG_LTE_LC_PSM_MODULE=n
#CONFIG_LTE_PSM_REQ_RPTAU="00101000"
# PSM requested active time 6 seconds
#CONFIG_LTE_PSM_REQ_RAT="00000011"

# AT Host library - 用于 AT 命令调试，咱们先关掉
CONFIG_AT_HOST_LIBRARY=n

########################
# Heap and stacks
########################
CONFIG_HEAP_MEM_POOL_SIZE=16384
CONFIG_MAIN_STACK_SIZE=4096
CONFIG_AT_MONITOR_HEAP_SIZE=1024
CONFIG_SYSTEM_WORKQUEUE_STACK_SIZE=4096

########################
# Network
########################
CONFIG_NETWORKING=y
CONFIG_NET_NATIVE=y
CONFIG_NET_IPV4=y
CONFIG_NET_CONNECTION_MANAGER=y

# 不启用 Zephyr 自己的软件 TLS（我们用的是 modem offload）
# 所以这里不要 CONFIG_NET_SOCKETS_SOCKOPT_TLS

########################
# AWS IoT / MQTT
########################
CONFIG_AWS_IOT=y

# 固定 client ID（也可以改用 hw_id，这里只是兜底）
CONFIG_AWS_IOT_CLIENT_ID_STATIC="device_horse"

# 你的 AWS IoT endpoint（注意和 AWS 控制台一致）
CONFIG_AWS_IOT_BROKER_HOST_NAME="aee37ebj3uql3-ats.iot.us-east-1.amazonaws.com"

# Shadow 相关 topic 订阅
CONFIG_AWS_IOT_TOPIC_UPDATE_DELTA_SUBSCRIBE=y
CONFIG_AWS_IOT_TOPIC_GET_ACCEPTED_SUBSCRIBE=y
CONFIG_AWS_IOT_TOPIC_GET_REJECTED_SUBSCRIBE=y

# sample 里用到的一些 Kconfig（避免 undefined）
CONFIG_AWS_IOT_SAMPLE_APP_VERSION="v1.0.0"
CONFIG_AWS_IOT_SAMPLE_JSON_MESSAGE_SIZE_MAX=2048
CONFIG_AWS_IOT_SAMPLE_PUBLICATION_INTERVAL_SECONDS=60
CONFIG_AWS_IOT_SAMPLE_CONNECTION_RETRY_TIMEOUT_SECONDS=10

# 使用硬件 ID 作为 device_id（配合 main.c 里的 hw_id_get）
CONFIG_AWS_IOT_SAMPLE_DEVICE_ID_USE_HW_ID=y

########################
# MQTT helper library
########################
CONFIG_MQTT_HELPER=y
CONFIG_MQTT_HELPER_SEC_TAG=201
CONFIG_MQTT_HELPER_LAST_WILL=y
CONFIG_MQTT_HELPER_STACK_SIZE=4096
CONFIG_MQTT_HELPER_PORT=8883

# Maximum MQTT keepalive timeout specified by AWS IoT Core
CONFIG_MQTT_KEEPALIVE=1200
CONFIG_MQTT_CLEAN_SESSION=y

########################
# Modem / LTE
########################

# 让 socket 走 nRF91 调制解调器（包含 TLS offload）
CONFIG_NET_SOCKETS_OFFLOAD=y

# 一些库（比如 GNSS sample）会用到 POSIX API
CONFIG_POSIX_API=y

# LTE 链路控制
CONFIG_LTE_LINK_CONTROL=y

# ⭐ 最关键：让 modem 处于 LTE-M + GNSS 模式
CONFIG_LTE_NETWORK_MODE_LTE_M_GPS=y

# 旧版本里有 CONFIG_LTE_AUTO_INIT_AND_CONNECT，现在已经被移除
# 所以这里千万不要再写 CONFIG_LTE_AUTO_INIT_AND_CONNECT=...
# 由应用代码自己调用 lte_lc_init_and_connect()

# GNSS API 在当前 SDK 里不需要单独的 CONFIG_NRF_MODEM_GNSS 选项，
# 只要上面这个 LTE_M_GPS 打开即可。
# 以前我们写过：
# CONFIG_NRF_MODEM_GNSS=y
# 但这个符号在 NCS 3.0.2 里已经不存在，会导致 Kconfig 报 undefined symbol。
# 所以这里不要再加这行！

# 关闭 modem trace，省功耗
CONFIG_NRF_MODEM_LIB_TRACE=n

########################
# PDN / APN 配置
########################
CONFIG_PDN=y
CONFIG_PDN_DEFAULTS_OVERRIDE=y
# ✅ 按你要求保留这个“错误”的拼写
CONFIG_PDN_DEFAULT_APN="onomodo"

########################
# Modem key management (证书)
########################
CONFIG_MODEM_KEY_MGMT=y

########################
# Modem info（给 shadow 里面的 modem_version 用）
########################
CONFIG_MODEM_INFO=y

########################
# Modem library 基本设置
########################
CONFIG_NRF_MODEM_LIB=y
CONFIG_AT_CMD_CUSTOM=y

# Align the max FD entry to NRF_MODEM_MAX_SOCKET_COUNT(8)
CONFIG_ZVFS_OPEN_MAX=8

# Handle modem fault
CONFIG_NRF_MODEM_LIB_ON_FAULT_APPLICATION_SPECIFIC=y

########################
# ==== OTA (MCUboot + 下载客户端) ====
########################
CONFIG_AWS_FOTA=y
CONFIG_FOTA_DOWNLOAD=y
CONFIG_DFU_TARGET=y
CONFIG_IMG_MANAGER=y
CONFIG_MCUBOOT_IMG_MANAGER=y
CONFIG_BOOTLOADER_MCUBOOT=y
CONFIG_AWS_FOTA_DOWNLOAD_SECURITY_TAG=201

########################
# Memfault OTA (NCS 3.0.2 Compatible) — 先全部关掉
########################

# CONFIG_MEMFAULT=y
# CONFIG_MEMFAULT_SDK=y
# CONFIG_MEMFAULT_NCS_USE_DEFAULTS=y
# CONFIG_MEMFAULT_HTTP=y
# CONFIG_MEMFAULT_HTTP_UPLOAD=y
# CONFIG_MEMFAULT_FOTA=y
# CONFIG_IMG_ERASE_PROGRESSIVELY=y
# CONFIG_DOWNLOAD_CLIENT=y

# 允许较大的 SSL message（Memfault 或 AWS 大 payload 时有用）
CONFIG_MBEDTLS_SSL_MAX_CONTENT_LEN=4096
```

## src/main.c
```c
#include <zephyr/kernel.h>
#include <zephyr/sys/reboot.h>
#include <zephyr/dfu/mcuboot.h>
#include <zephyr/logging/log.h>
#include <zephyr/logging/log_ctrl.h>
#include <zephyr/net/conn_mgr_connectivity.h>
#include <zephyr/net/conn_mgr_monitor.h>
#include <net/aws_iot.h>
#include <stdio.h>
#include <stdlib.h>
#include <string.h>

#include <hw_id.h>
#include <modem/modem_info.h>
#include <modem/nrf_modem_lib.h>
#include <modem/lte_lc.h>

#include "json_payload.h"
#include "horse_payload.h"
#include "gnss_task.h"

////////////////////////// FOTA //////////////////////////////////
#include <net/aws_fota.h>

LOG_MODULE_REGISTER(aws_iot_sample, CONFIG_AWS_IOT_SAMPLE_LOG_LEVEL);

/*=============================== FOTA handler ===========================*/

static void aws_fota_evt_handler(struct aws_fota_event *evt)
{
    switch (evt->id) {
    case AWS_FOTA_EVT_START:
        LOG_INF("AWS FOTA: Update started");
        break;

    case AWS_FOTA_EVT_DL_PROGRESS:
        LOG_INF("AWS FOTA: Download %d%%", evt->dl.progress);
        break;

    case AWS_FOTA_EVT_ERASE_PENDING:
        LOG_INF("AWS FOTA: Flash erase pending...");
        break;

    case AWS_FOTA_EVT_ERASE_DONE:
        LOG_INF("AWS FOTA: Flash erase complete, rebooting...");
        sys_reboot(SYS_REBOOT_COLD);
        break;

    case AWS_FOTA_EVT_DONE:
        LOG_INF("AWS FOTA: Update done (image=%d)", evt->image);
        break;

    case AWS_FOTA_EVT_ERROR:
        LOG_ERR("AWS FOTA: Error occurred");
        break;

    default:
        LOG_WRN("AWS FOTA: Unknown event %d", evt->id);
        break;
    }
}

/*=============================== parameter ==========================*/

/* 统一 horse_data 上报间隔（秒） */
#define HORSE_DATA_INTERVAL_SEC 120

/*=============================== horse_data work ==========================*/
static void horse_data_work_fn(struct k_work *work);
K_WORK_DELAYABLE_DEFINE(horse_data_work, horse_data_work_fn);

/*========================================== horse_data =======================================*/
void publish_horse_data(float temperature, float moisture, float pitch,
                        float gps_lat, float gps_lon,
                        int water_flag, int water_time)
{
    char json_buf[256];
    struct horse_payload hp;

    /* new fields */
    hp.water_flag = water_flag;
    hp.water_time = water_time;

    /* existing fields */
    hp.temperature = (int32_t)(temperature * 100.0f);
    hp.moisture    = (int32_t)(moisture * 100.0f);
    hp.pitch       = (int32_t)(pitch * 100.0f);
    hp.latitude    = (int32_t)(gps_lat * 1000000.0f);
    hp.longitude   = (int32_t)(gps_lon * 1000000.0f);

    if (horse_payload_construct(json_buf, sizeof(json_buf), &hp)) {
        printk("horse_payload_construct failed\n");
        return;
    }

    struct aws_iot_data tx = { 0 };
    tx.qos       = MQTT_QOS_1_AT_LEAST_ONCE;
    tx.ptr       = json_buf;
    tx.len       = strlen(json_buf);
    tx.topic.str = "horse_data";
    tx.topic.len = strlen(tx.topic.str);

    int err = aws_iot_send(&tx);
    if (err) {
        LOG_ERR("aws_iot_send (horse_data) failed: %d", err);
    }

    printk("horse_data sent: %s\n", json_buf);
}

/* ================= horse_data update work ================= */
static void horse_data_work_fn(struct k_work *work)
{
    ARG_UNUSED(work);

    struct gnss_status_msg msg;
    static struct gnss_status_msg last_msg = {0};

    /* 把队列里累积的数据读到最后一条 */
    int got_msg = 0;
    while (k_msgq_get(&gnss_msgq, &msg, K_NO_WAIT) == 0) {
        got_msg = 1;
    }

    /* 只有在真的从 GNSS 收到消息时才更新 last_msg；
     * 并且只在 lat/lon 非 0 时覆盖，避免把 0 覆盖掉已有的有效坐标。
     */
    if (got_msg) {
        if (msg.lat != 0.0f || msg.lon != 0.0f) {
            last_msg = msg;
        }
    }

    publish_horse_data(
        23.5f,                          /* TODO: 替换成真实温度 */
        56.7f,                          /* TODO: 替换成真实湿度 */
        12.8f,                          /* TODO: 替换成真实 pitch */
        last_msg.lat,
        last_msg.lon,
        last_msg.is_water_gnss ? 1 : 0,
        (int)last_msg.total_water_s
    );

    /* 下次上报 */
    k_work_reschedule(&horse_data_work, K_SECONDS(HORSE_DATA_INTERVAL_SEC));
}

/*========================= NET / AWS 相关 =========================*/

#define L4_EVENT_MASK         (NET_EVENT_L4_CONNECTED | NET_EVENT_L4_DISCONNECTED)
#define CONN_LAYER_EVENT_MASK (NET_EVENT_CONN_IF_FATAL_ERROR)

#define MODEM_FIRMWARE_VERSION_SIZE_MAX 50

#define MY_CUSTOM_TOPIC_1 "my-custom-topic/example"
#define MY_CUSTOM_TOPIC_2 "my-custom-topic/example_2"

#define FATAL_ERROR()                             \
    LOG_ERR("Fatal error! Rebooting the device.");\
    LOG_PANIC();                                  \
    IF_ENABLED(CONFIG_REBOOT, (sys_reboot(0)))

static struct net_mgmt_event_callback l4_cb;
static struct net_mgmt_event_callback conn_cb;

static char hw_id[HW_ID_LEN];

static void shadow_update_work_fn(struct k_work *work);
static void connect_work_fn(struct k_work *work);
static void aws_iot_event_handler(const struct aws_iot_evt *const evt);

/* AWS shadow 定时上报 & 连接重试 */
static K_WORK_DELAYABLE_DEFINE(shadow_update_work, shadow_update_work_fn);
static K_WORK_DELAYABLE_DEFINE(connect_work, connect_work_fn);

/* GNSS 启动的 work，避免在 net_mgmt 线程里直接调 */
static void gnss_start_work_fn(struct k_work *work);
static K_WORK_DEFINE(gnss_start_work, gnss_start_work_fn);

/* ================= Application topics ================= */

static int app_topics_subscribe(void)
{
    int err;
    static const struct mqtt_topic topic_list[] = {
        {
            .topic.utf8 = MY_CUSTOM_TOPIC_1,
            .topic.size = sizeof(MY_CUSTOM_TOPIC_1) - 1,
            .qos = MQTT_QOS_1_AT_LEAST_ONCE,
        },
        {
            .topic.utf8 = MY_CUSTOM_TOPIC_2,
            .topic.size = sizeof(MY_CUSTOM_TOPIC_2) - 1,
            .qos = MQTT_QOS_1_AT_LEAST_ONCE,
        },
        {
            .topic.utf8 = "horse_data",
            .topic.size = sizeof("horse_data") - 1,
            .qos = MQTT_QOS_1_AT_LEAST_ONCE,
        }
    };

    err = aws_iot_application_topics_set(topic_list, ARRAY_SIZE(topic_list));
    if (err) {
        LOG_ERR("aws_iot_application_topics_set, error: %d", err);
        FATAL_ERROR();
        return err;
    }

    return 0;
}

/* ================= AWS IoT client init ================= */

static int aws_iot_client_init(void)
{
    int err;

    printk("=== aws_iot_client_init: start ===\n");

    err = aws_iot_init(aws_iot_event_handler);
    if (err) {
        LOG_ERR("AWS IoT library could not be initialized, error: %d", err);
        FATAL_ERROR();
        return err;
    }

    printk("=== aws_iot_client_init: aws_iot_init OK ===\n");

    err = app_topics_subscribe();
    if (err) {
        LOG_ERR("Adding application specific topics failed, error: %d", err);
        FATAL_ERROR();
        return err;
    }

    printk("=== aws_iot_client_init: topics subscribed OK ===\n");

    return 0;
}

/* ================= Shadow update work ================= */

static void shadow_update_work_fn(struct k_work *work)
{
    ARG_UNUSED(work);

    int err;
    char message[CONFIG_AWS_IOT_SAMPLE_JSON_MESSAGE_SIZE_MAX] = { 0 };
    struct payload payload = {
        .state.reported.uptime = k_uptime_get(),
        .state.reported.app_version = CONFIG_AWS_IOT_SAMPLE_APP_VERSION,
    };
    struct aws_iot_data tx_data = {
        .qos = MQTT_QOS_0_AT_MOST_ONCE,
        .topic.type = AWS_IOT_SHADOW_TOPIC_UPDATE,
    };

    if (IS_ENABLED(CONFIG_MODEM_INFO)) {
        char modem_version_temp[MODEM_FIRMWARE_VERSION_SIZE_MAX];

        err = modem_info_get_fw_version(modem_version_temp,
                                        ARRAY_SIZE(modem_version_temp));
        if (err) {
            LOG_ERR("modem_info_get_fw_version, error: %d", err);
            FATAL_ERROR();
            return;
        }

        payload.state.reported.modem_version = modem_version_temp;
    }

    err = json_payload_construct(message, sizeof(message), &payload);
    if (err) {
        LOG_ERR("json_payload_construct, error: %d", err);
        FATAL_ERROR();
        return;
    }

    tx_data.ptr = message;
    tx_data.len = strlen(message);

    LOG_INF("Publishing message: %s to AWS IoT shadow", message);

    err = aws_iot_send(&tx_data);
    if (err) {
        LOG_ERR("aws_iot_send, error: %d", err);
        FATAL_ERROR();
        return;
    }

    (void)k_work_reschedule(&shadow_update_work,
        K_SECONDS(CONFIG_AWS_IOT_SAMPLE_PUBLICATION_INTERVAL_SECONDS));
}

/* ================= Connect work ================= */

static void connect_work_fn(struct k_work *work)
{
    ARG_UNUSED(work);

    int err;
    const struct aws_iot_config config = {
        .client_id = hw_id,
    };

    LOG_INF("Connecting to AWS IoT (client_id: %s, host: %s, port: %d)",
        hw_id,
        CONFIG_AWS_IOT_BROKER_HOST_NAME,
#ifdef CONFIG_MQTT_HELPER_PORT
        CONFIG_MQTT_HELPER_PORT
#else
        -1
#endif
    );

    err = aws_iot_connect(&config);
    printk("=== connect_work_fn: aws_iot_connect() returned: %d ===\n", err);

    if (err == -EAGAIN) {
        LOG_INF("Connection attempt timed out, next retry in %d seconds",
            CONFIG_AWS_IOT_SAMPLE_CONNECTION_RETRY_TIMEOUT_SECONDS);

        (void)k_work_reschedule(&connect_work,
            K_SECONDS(CONFIG_AWS_IOT_SAMPLE_CONNECTION_RETRY_TIMEOUT_SECONDS));
    } else if (err) {
        LOG_ERR("aws_iot_connect, error: %d", err);
        FATAL_ERROR();
    }
}

/* ================= AWS IoT event handler ================= */

static void on_aws_iot_evt_connected(const struct aws_iot_evt *const evt)
{
    (void)k_work_cancel_delayable(&connect_work);

    if (evt->data.persistent_session) {
        LOG_WRN("Persistent session enabled, reusing subscriptions");
    }

#if defined(CONFIG_BOOTLOADER_MCUBOOT)
    boot_write_img_confirmed();
#endif

    /* 启动 shadow 上报 & horse_data 定时上报 */
    (void)k_work_reschedule(&shadow_update_work, K_NO_WAIT);
    (void)k_work_reschedule(&horse_data_work, K_SECONDS(HORSE_DATA_INTERVAL_SEC));
}

static void on_aws_iot_evt_disconnected(void)
{
    (void)k_work_cancel_delayable(&shadow_update_work);
    (void)k_work_reschedule(&connect_work, K_SECONDS(5));
}

static void aws_iot_event_handler(const struct aws_iot_evt *const evt)
{
    switch (evt->type) {
    case AWS_IOT_EVT_CONNECTING:
        LOG_INF("AWS_IOT_EVT_CONNECTING");
        break;
    case AWS_IOT_EVT_CONNECTED:
        LOG_INF("AWS_IOT_EVT_CONNECTED");
        on_aws_iot_evt_connected(evt);
        break;
    case AWS_IOT_EVT_DISCONNECTED:
        LOG_INF("AWS_IOT_EVT_DISCONNECTED");
        on_aws_iot_evt_disconnected();
        break;
    case AWS_IOT_EVT_DATA_RECEIVED:
        LOG_INF("AWS_IOT_EVT_DATA_RECEIVED");
        LOG_INF("Received: \"%.*s\" on \"%.*s\"",
            evt->data.msg.len, evt->data.msg.ptr,
            evt->data.msg.topic.len, evt->data.msg.topic.str);
        break;
    case AWS_IOT_EVT_PUBACK:
        LOG_INF("AWS_IOT_EVT_PUBACK id=%d", evt->data.message_id);
        break;
    case AWS_IOT_EVT_PINGRESP:
        LOG_INF("AWS_IOT_EVT_PINGRESP");
        break;
    case AWS_IOT_EVT_ERROR:
        LOG_INF("AWS_IOT_EVT_ERROR %d", evt->data.err);
        FATAL_ERROR();
        break;
    default:
        LOG_WRN("Unknown AWS IoT event %d", evt->type);
        break;
    }
}

/* ================= GNSS start work ================= */

static void gnss_start_work_fn(struct k_work *work)
{
    ARG_UNUSED(work);

    /* 现在 gnss_start_after_lte_ready() 是 void，内部自己打印错误或成功日志 */
    gnss_start_after_lte_ready();
}

/* ================= Network event handlers ================= */

static void l4_event_handler(struct net_mgmt_event_callback *cb,
                 uint32_t event,
                 struct net_if *iface)
{
    ARG_UNUSED(cb);
    ARG_UNUSED(iface);

    switch (event) {
    case NET_EVENT_L4_CONNECTED:
        LOG_INF("Network connectivity established");
        printk("=== L4_CONNECTED: scheduling connect_work ===\n");

        /* 不在 net_mgmt 线程里直接起 GNSS，改为提交 work，防止栈溢出 */
        k_work_submit(&gnss_start_work);

        (void)k_work_schedule(&connect_work, K_NO_WAIT);
        break;
    case NET_EVENT_L4_DISCONNECTED:
        LOG_INF("Network connectivity lost");
        break;
    default:
        return;
    }
}

static void connectivity_event_handler(struct net_mgmt_event_callback *cb,
                       uint32_t event,
                       struct net_if *iface)
{
    ARG_UNUSED(cb);
    ARG_UNUSED(iface);

    if (event == NET_EVENT_CONN_IF_FATAL_ERROR) {
        LOG_ERR("NET_EVENT_CONN_IF_FATAL_ERROR");
        FATAL_ERROR();
    }
}

/* ============================ main ============================ */

int main(void)
{
    int err;

    LOG_INF("Main(LTE) app starting...");

    /* Step 1: 初始化 Modem（但不启动 LTE） */
    err = nrf_modem_lib_init();
    if (err) {
        LOG_ERR("nrf_modem_lib_init failed, err %d", err);
        return err;
    }

    /* Step 2: 写 AWS 证书 (必须在 LTE 连接前) */
    extern int provision_credentials(void);
    err = provision_credentials();
    if (err) {
        LOG_ERR("provision_credentials failed: %d", err);
        FATAL_ERROR();
        return err;
    }

    /* Step 3: 初始化 GNSS Task（线程已在 K_THREAD_DEFINE 中启动） */
    err = gnss_system_init();
    if (err) {
        LOG_ERR("gnss_system_init failed: %d", err);
    }

    /* Step 4: 注册 LTE 链路事件回调 */
    net_mgmt_init_event_callback(&l4_cb, l4_event_handler, L4_EVENT_MASK);
    net_mgmt_add_event_callback(&l4_cb);

    net_mgmt_init_event_callback(&conn_cb, connectivity_event_handler,
                                 CONN_LAYER_EVENT_MASK);
    net_mgmt_add_event_callback(&conn_cb);

    printk("=== HELLDIVERS AWS MAIN, built at " __DATE__ " " __TIME__ " ===\n");
    LOG_INF("Bringing network interface up and connecting");
    printk("=== Before conn_mgr_all_if_up ===\n");

    /* Step 5: 启动 LTE (Modem 上线) */
    err = conn_mgr_all_if_up(true);
    printk("=== conn_mgr_all_if_up() returned: %d ===\n", err);
    if (err) {
        LOG_ERR("conn_mgr_all_if_up error: %d", err);
        FATAL_ERROR();
        return err;
    }

    printk("=== Before conn_mgr_all_if_connect ===\n");

    /* Step 6: 连接移动网络，成功后进入 L4_CONNECTED 事件处理 */
    err = conn_mgr_all_if_connect(true);
    printk("=== conn_mgr_all_if_connect() returned: %d ===\n", err);
    if (err) {
        LOG_ERR("conn_mgr_all_if_connect error: %d", err);
        FATAL_ERROR();
        return err;
    }

    /* Step 7: 设置 AWS Client ID */
#if defined(CONFIG_AWS_IOT_SAMPLE_CLIENT_ID_USE_HW_ID)
    err = hw_id_get(hw_id, ARRAY_SIZE(hw_id));
    printk("=== hw_id_get() returned: %d ===\n", err);
    if (err) {
        LOG_ERR("Failed to retrieve hardware ID, error: %d", err);
        FATAL_ERROR();
        return err;
    }
    LOG_INF("Hardware ID: %s", hw_id);
    printk("=== Hardware ID: %s ===\n", hw_id);
#else
    snprintf(hw_id, sizeof(hw_id), "%s", CONFIG_AWS_IOT_CLIENT_ID_STATIC);
    LOG_INF("Using static client ID as hw_id: %s", hw_id);
    printk("=== Using static client ID as hw_id: %s ===\n", hw_id);
#endif

    printk("=== Before aws_iot_client_init ===\n");

    /* Step 8: 初始化 AWS IoT（不连接） */
    err = aws_iot_client_init();
    printk("=== aws_iot_client_init() returned: %d ===\n", err);
    if (err) {
        LOG_ERR("aws_iot_client_init error: %d", err);
        FATAL_ERROR();
        return err;
    }

    /* Step 9: 如需 FOTA 可在此初始化（当前注释掉以免干扰） */
    /*
    err = aws_fota_init(aws_fota_evt_handler);
    if (err) {
        LOG_ERR("aws_fota_init failed: %d", err);
    } else {
        LOG_INF("AWS FOTA initialized");
    }
    */

    printk("=== main() finished, waiting for events ===\n");

    return 0;
}
```

## src/cert_provision.c
```c
#include <zephyr/logging/log.h>
#include <modem/modem_key_mgmt.h>
#include <string.h>

LOG_MODULE_REGISTER(cert_provision, CONFIG_LOG_DEFAULT_LEVEL);

/* Must match CONFIG_MQTT_HELPER_SEC_TAG in prj.conf */
#define SEC_TAG 201

/* AWS Root CA (AmazonRootCA1.pem) */
static const char aws_root_ca_pem[] =
"-----BEGIN CERTIFICATE-----\n"
"MIIDQTCCAimgAwIBAgITBmyfz5m/jAo54vB4ikPmljZbyjANBgkqhkiG9w0BAQsF\n"
"ADA5MQswCQYDVQQGEwJVUzEPMA0GA1UEChMGQW1hem9uMRkwFwYDVQQDExBBbWF6\n"
"b24gUm9vdCBDQSAxMB4XDTE1MDUyNjAwMDAwMFoXDTM4MDExNzAwMDAwMFowOTEL\n"
"MAkGA1UEBhMCVVMxDzANBgNVBAoTBkFtYXpvbjEZMBcGA1UEAxMQQW1hem9uIFJv\n"
"b3QgQ0EgMTCCASIwDQYJKoZIhvcNAQEBBQADggEPADCCAQoCggEBALJ4gHHKeNXj\n"
"ca9HgFB0fW7Y14h29Jlo91ghYPl0hAEvrAIthtOgQ3pOsqTQNroBvo3bSMgHFzZM\n"
"9O6II8c+6zf1tRn4SWiw3te5djgdYZ6k/oI2peVKVuRF4fn9tBb6dNqcmzU5L/qw\n"
"IFAGbHrQgLKm+a/sRxmPUDgH3KKHOVj4utWp+UhnMJbulHheb4mjUcAwhmahRWa6\n"
"VOujw5H5SNz/0egwLX0tdHA114gk957EWW67c4cX8jJGKLhD+rcdqsq08p8kDi1L\n"
"93FcXmn/qoQj8WDtxJiqZ6m9FFZoPBzH+YF2dUyCBj4N3utoFWvAiJZPmnfntr6i\n"
"R8+N+3G3kpkCAwEAAaNCMEAwDwYDVR0TAQH/BAUwAwEB/zAOBgNVHQ8BAf8EBAMC\n"
"AYYwHQYDVR0OBBYEFIQYzIU07LwMlJQuCFmcx7IQTgoIMA0GCSqGSIb3DQEBCwUA\n"
"A4IBAQCY8jdaQZChGsV2USggNiMOruYou6r4lK5IpDB/G/wkjUu0yKGX9rbxenDI\n"
"U5PMCCjjmCx7ycQeFZ4s+pHoO0etp6bI/+FFkCGCzBPC4mPdFiAceBCLgLnu3bkq\n"
"jB0Tt13ZTQWeK6yjM/rb+UZU7dY8LGtFZ7l4I8Mbcn8i5BZm0laUfqR61NrvU+1h\n"
"INHY5GHA3ny3gjxYa3kBs7qNgBi7qKPvXxLVv9o/ICgOo3T9qs/5cY5knld0yHtA\n"
"yxB3T7zINBuCvdT2Vwh3i3TJE6r1pisGLFyy0Awamu7eV/qjpqVWh3D48KMFzXRI\n"
"2zGh6Ycx/j6K+tD8qjdkSOnC3FIq\n"
"-----END CERTIFICATE-----\n";

/* Device certificate (…certificate.pem.crt) */
static const char client_cert_pem[] =
"-----BEGIN CERTIFICATE-----\n"
"MIIDWTCCAkGgAwIBAgIUcNVSFNS2LuIrD7eo0rVpSgEljpYwDQYJKoZIhvcNAQEL\n"
"BQAwTTFLMEkGA1UECwxCQW1hem9uIFdlYiBTZXJ2aWNlcyBPPUFtYXpvbi5jb20g\n"
"SW5jLiBMPVNlYXR0bGUgU1Q9V2FzaGluZ3RvbiBDPVVTMB4XDTI1MTExMTA0MTI0\n"
"MVoXDTQ5MTIzMTIzNTk1OVowHjEcMBoGA1UEAwwTQVdTIElvVCBDZXJ0aWZpY2F0\n"
"ZTCCASIwDQYJKoZIhvcNAQEBBQADggEPADCCAQoCggEBAK+63da/k5PhOdEI6udp\n"
"wKaNlYDVogNodSz/P46whUgSg/wsC1zgCo+5OZK7u22yk1ycPT495Qjm7mvo+e5+\n"
"Cwhyrc8yzNq1pGsrnDBq51pKruko8Dd7QH4qZyo7uo5MP2OwkzDvQHOz9/+clSQK\n"
"Oi3yCaE7H6dEtw8TADrFoY4eHryGPxJfEuphJIdnFTfCPccXl/FuiI+kCaZ2isX3\n"
"kK6blL+dQoGZWEmbVb91T1slSiUBKB0OeqouOdT0PWD3KIoy6/Ml6IvAUyLVyflp\n"
"YfVStSs7+TJocznoHn2jKjSn6X3JM3Ztnt0yhu7LT5YotR1NH+jLmfG/zGsoPE81\n"
"/jsCAwEAAaNgMF4wHwYDVR0jBBgwFoAU5+GAl4xSo9meHLsFp6bCTdZYPgQwHQYD\n"
"VR0OBBYEFFAENZbslGi5go8gnnEODAqFS6WNMAwGA1UdEwEB/wQCMAAwDgYDVR0P\n"
"AQH/BAQDAgWgMA0GCSqGSIb3DQEBCwUAA4IBAQBJARnjeOXdlGafu/ceE3CvhnUL\n"
"QlUL/pmVKZG3w3JxSHzxWsejzzTpEzTAtEAoqXhz+Yj9/PrCrlzckQmowdP7aIXk\n"
"2O3X4C3DGBsCoU9QO6GUTsjC7bGk7MyO9jnXfhetf6zWV8M9nu+exwG1d3cN26a5\n"
"I2OCQstjEqN7v7tIPnF5kRAXSgXPZsbz3es2mHE//khoyiQ9k0BwtigMkjg/5YwU\n"
"1YFKCJjFA+sbbhyaKaDpXozYdOtbKHLtHWJQbfC3e6xMqJrSBbVOEYVCu4HZzCKD\n"
"rLySI75JhIsirS3MOFqYlaKuUkZ4zmJPm3MiXHeIW74a9iZptTQ6pqyxq8gf\n"
"-----END CERTIFICATE-----\n";

/* Device private key (…private.pem.key) */
static const char client_key_pem[] =
"-----BEGIN RSA PRIVATE KEY-----\n"
"MIIEogIBAAKCAQEAr7rd1r+Tk+E50Qjq52vApo2VgNWgDaHUs/z+OsIVIMoP8LXO\n"
"AKj7k5kru7tspNcnD0+PeUI5u5r6PnufgsIcq3/MszataRrK5wwaudaSq7pK/A3e\n"
"0B+KmcqG7qOOTD9jsJMA70Bzs/f/nJUkCjot8gmhOx+nRLcPEwA6xaGOHh68hj8S\n"
"XxLqYCSXZxU3wj3HF5fxboiPpAmmdorF95Cum5S/nUKBmVhLm1W/dU9bJUolASgd\n"
"DnqqLjnU9D1gtyiKMuvzJeiLwFMi1cn5qWH1UrNLO/kyaHM56B0WYXk7qs0RIhbG\n"
"xAdqJItqC2E21C66p9cO158bbZthXXMf6fCgkQIDAQABAoIBAAfkamQBjWE0oa2Q\n"
"JE+H5CkSLJQpWucG2IRF5FzbPsrOMq3TkpZBTptDXVRr2rn/lgLyyK3XKXgWkMgP\n"
"ePl3Rx1aIIPVkRtpYTDgun/tS5kCDDfm3bflSUaP7BtCyY0jIp4Rkd5gElwegcNq\n"
"KZMTxcTt4Jx7vmSAvGXAXWZXjnwHuaWDhrMNWMp401KsdJ7aGLjiMCawQP8MQJ7y\n"
"lUko4VyXR+Ob2BvqbYehaq212QBzzyLjEbLoB5Tkf9zsgtR02LVB37N8+C2dzVJx\n"
"m+OdWSowxZqG2a7odlUTmXnhI3/M1Ryk1hXAOUvZSu7i5mZV2jzRTZFF27ecxGle\n"
"yVVsxGkCgYEA1Z1TBQKrXWO/1bpjuo5D5/kVfn/ZyMP+Ik6Yp8LWXO/LIA5fVzoY\n"
"40Ec5QtFV0RjI1fQsj83qNAhtu8w+llBzt4xspQkHpau+l7lV4bGG4nZd8Nh8pJ/\n"
"ctW/Y7VLSI0/wXpfiCv6skLjGtXocA+bzM5Rf7MXG/xxIXQYsdoq9Z0CgYEAw1pO\n"
"9YBRhKaY3dec01FG/B5DAWPStinUizvVJ01lXdXAuyGb91hpnLd8aj5P1kLVYEp+\n"
"hQj71BtzdALmWACFZ6dHcof445Siu7bJKz1YVu41VkXB+dql5SgmoCRTE4zD13bV\n"
"P+Y5eRKOoafcq2yWn0+pKA9b45yjaER46DdthJkCgYBu5Nm5Qc4UVkX/QE3QzvdY\n"
"OUtdBpXUIuoFQifgjWeeRJWqrw6LLEgfl4oA2Jdqmqm9iczKh5obkXYDDmFFHUlS\n"
"ALSR/ttiyH+tUtC1OO+TKCbNaUDGBzugnpV6Mozl4Wg7bjSC1z7wgoYbqSnOfBe7\n"
"DeIC5ZLIUZMYmneViJ20PQKBgDRuJycY83HMEczvOsVPPVGCZMjf9nOyVFYA2zM0\n"
"7QcuzxqpQK1q7QHBpc0YEeSLUIQEcM6RYDxs25aNwXvejBY+yf+cZiXAmqksXpoL\n"
"Kl1H1QlDfmg1Q+62vFQtkPFQcZQLmWRlku9HbjNho2VnnUYQLH2TQTr/cvQFdb1v\n"
"BLvjAoGAPthOUtMFkhm6GmSkmzye0VW7FvEBmMSeCYOP820WQw8/s9yJ5Z+1pEfh\n"
"93HK2j11O9ljyYYgiL1kKrybmPAFYdLRi4+ngturlQmPUejdtlBer0HSdXOCcO26\n"
"tq9Oym1v3LBrJBLnFMYULh/4ZG9O6N7E4I3+b5khBslH36r+TI0=\n"
"-----END RSA PRIVATE KEY-----\n";

static int write_cred(int tag, enum modem_key_mgmt_cred_type type, const char *src)
{
    int err = modem_key_mgmt_write(tag, type, src, strlen(src));
    if (err) {
        LOG_ERR("modem_key_mgmt_write(tag=%d, type=%d) failed: %d", tag, type, err);
        return err;
    }
    LOG_INF("Stored credential type %d in sec tag %d", type, tag);
    return 0;
}

int provision_credentials(void)
{
    int err;

    LOG_INF("Provisioning credentials into sec tag %d", SEC_TAG);

    /* 调试阶段：每次启动都先删掉旧的，再写新的 */
    (void)modem_key_mgmt_delete(SEC_TAG, MODEM_KEY_MGMT_CRED_TYPE_CA_CHAIN);
    (void)modem_key_mgmt_delete(SEC_TAG, MODEM_KEY_MGMT_CRED_TYPE_PUBLIC_CERT);
    (void)modem_key_mgmt_delete(SEC_TAG, MODEM_KEY_MGMT_CRED_TYPE_PRIVATE_CERT);

    err = write_cred(SEC_TAG, MODEM_KEY_MGMT_CRED_TYPE_CA_CHAIN, aws_root_ca_pem);
    if (err) {
        return err;
    }

    err = write_cred(SEC_TAG, MODEM_KEY_MGMT_CRED_TYPE_PUBLIC_CERT, client_cert_pem);
    if (err) {
        return err;
    }

    err = write_cred(SEC_TAG, MODEM_KEY_MGMT_CRED_TYPE_PRIVATE_CERT, client_key_pem);
    if (err) {
        return err;
    }

    LOG_INF("Credential provisioning finished OK");
    return 0;
}
```
