## CMakeLists.txt
```
cmake_minimum_required(VERSION 3.20.0)
find_package(Zephyr REQUIRED HINTS $ENV{ZEPHYR_BASE})
project(core_dump)

target_sources(app PRIVATE src/main.c)
```

## prj.conf
```kconfig
# 基础
CONFIG_GPIO=y
CONFIG_SERIAL=y
CONFIG_CONSOLE=y
CONFIG_UART_CONSOLE=y

CONFIG_MAIN_STACK_SIZE=4096
CONFIG_HEAP_MEM_POOL_SIZE=4096

# 日志
CONFIG_LOG=y
CONFIG_LOG_MODE_IMMEDIATE=y

# Shell，用来跑 mflt 命令
CONFIG_SHELL=y
CONFIG_SHELL_BACKEND_SERIAL=y
CONFIG_SHELL_CMDS=y

# 网络：使用 modem offload sockets
CONFIG_NETWORKING=y
CONFIG_NET_NATIVE=n
CONFIG_NET_IPV4=y
CONFIG_NET_SOCKETS=y
CONFIG_NET_SOCKETS_OFFLOAD=y

# Modem + LTE
CONFIG_NRF_MODEM_LIB=y
CONFIG_LTE_LINK_CONTROL=y

# TLS/证书存储
CONFIG_MODEM_KEY_MGMT=y
CONFIG_MODEM_INFO=y

# ------- Memfault -------

# 启用 Memfault
CONFIG_MEMFAULT=y

# Shell 支持：生成 mflt 命令
CONFIG_MEMFAULT_SHELL=y

# 用 IMEI 作为 Device ID
CONFIG_MEMFAULT_NCS_DEVICE_ID_IMEI=y

# Memfault project key（这里换成你自己的）
CONFIG_MEMFAULT_NCS_PROJECT_KEY="I5aB17gfhuZUcQZzToFN2FFU3SBySlrG"

# 默认 metrics 集合
CONFIG_MEMFAULT_METRICS_DEFAULT_SET_ENABLE=y

# HTTP 上传
CONFIG_MEMFAULT_HTTP_ENABLE=y
CONFIG_MEMFAULT_HTTP_PERIODIC_UPLOAD=y
CONFIG_MEMFAULT_HTTP_PERIODIC_UPLOAD_INTERVAL_SECS=300

# 把 Memfault 根证书写入 nRF91 modem key storage
CONFIG_MEMFAULT_ROOT_CERT_STORAGE_NRF9160_MODEM=y
```

## src/main.c
```c
#include <zephyr/kernel.h>
#include <zephyr/logging/log.h>
#include <zephyr/drivers/gpio.h>

#include <modem/nrf_modem_lib.h>
#include <modem/lte_lc.h>

LOG_MODULE_REGISTER(core_dump, LOG_LEVEL_INF);

/* 使用板子的 led0 alias */
#define LED0_NODE DT_ALIAS(led0)

#if !DT_NODE_HAS_STATUS(LED0_NODE, okay)
#error "Unsupported board: led0 alias is not defined in devicetree"
#endif

static const struct gpio_dt_spec led0 = GPIO_DT_SPEC_GET(LED0_NODE, gpios);

/* 初始化 modem + 同步连接 LTE-M */
static void modem_init_and_connect(void)
{
    int err;

    LOG_INF("Initializing nRF modem library");

    err = nrf_modem_lib_init();
    if (err < 0) {
        LOG_ERR("nrf_modem_lib_init() failed, err %d", err);
        return;
    }

    LOG_INF("Connecting LTE (blocking)...");
    /* 在新版本 NCS 里，用 lte_lc_connect() 代替 lte_lc_init_and_connect() */
    err = lte_lc_connect();
    if (err) {
        LOG_ERR("lte_lc_connect() failed, err %d", err);
    } else {
        LOG_INF("LTE connected");
    }
}

void main(void)
{
    int ret;

    LOG_INF("core_dump blinky with LTE start");

    if (!device_is_ready(led0.port)) {
        LOG_ERR("LED device not ready");
        return;
    }

    ret = gpio_pin_configure_dt(&led0, GPIO_OUTPUT_INACTIVE);
    if (ret != 0) {
        LOG_ERR("Failed to configure LED pin, err %d", ret);
        return;
    }

    /* 初始化 modem + 连接 LTE-M */
    modem_init_and_connect();

    /* 
     * 如果你想测试 Memfault coredump，可以在下面加一个“自杀”故障，例如：
     *
     *   k_sleep(K_SECONDS(30));
     *   volatile int *bad = (int *)0x0;
     *   *bad = 42;   // 故意造成 HardFault，Memfault 会抓 core dump
     *
     * 先确认能正常连接、LED 闪，再自己按需要打开。
     */

    while (1) {
        gpio_pin_toggle_dt(&led0);
        k_sleep(K_SECONDS(1));
    }
}
```
