## aws_iot_sensor/tests/balance/testcase.yaml
```yaml
tests:
  horse.balance.unit:
    platform_allow: qemu_cortex_m3
    tags: horse balance
    harness: ztest
    timeout: 120
```

## sensor_shell/build/Kconfig/boards/Kconfig
```kconfig
# Load Zephyr board Kconfig descriptions.
osource "C:/ncs/v3.0.2/zephyr/boards/nordic/nrf9151dk/Kconfig"
```

## sensor_shell/build/sensor_shell/Kconfig/boards/Kconfig.defconfig
```kconfig
# Load Zephyr board defconfig descriptions.
osource "C:/ncs/v3.0.2/zephyr/boards/nordic/nrf9151dk/Kconfig.defconfig"
```

## sensor_shell/twister-out/qemu_cortex_m3_ti_lm3s6965/zephyr/samples/sensor/sensor_shell/tests/balance/horse.balance.unit/Kconfig/boards/Kconfig
```kconfig
# Load Zephyr board Kconfig descriptions.
osource "C:/ncs/v3.0.2/zephyr/boards/qemu/cortex_m3/Kconfig"
```

## sensor_shell/twister-out/qemu_cortex_m3_ti_lm3s6965/zephyr/samples/sensor/sensor_shell/tests/balance/horse.balance.unit/Kconfig/boards/Kconfig.defconfig
```kconfig
# Load Zephyr board defconfig descriptions.
osource "C:/ncs/v3.0.2/zephyr/boards/qemu/cortex_m3/Kconfig.defconfig"
```
